## boards/arm/gus_bl652/Kconfig.defconfig
```kconfig
# BL652 DVK board configuration

# Copyright (c) 2019 Laird Connectivity
# SPDX-License-Identifier: Apache-2.0

if BOARD_AZ_BL652

config BOARD
	default "az_bl652"

config BT_CTLR
	default BT

endif # BOARD_AZ_BL652
```
